## main/Kconfig.projbuild
```kconfig
menu "SD-WAN USB modem emulator"
config EMU_LINUX_RNDIS
    bool "Use Linux f_rndis compatible 02/02/ff class"
    default y
config EMU_AT_USB
    bool "Add experimental CDC ACM AT port beside RNDIS"
    default n
    depends on TINYUSB_CDC_ENABLED
config EMU_MBIM
    bool "Use MBIM instead of RNDIS (experimental)"
    default n
    depends on !EMU_AT_USB
endmenu
```

## sdkconfig.defaults
```kconfig
CONFIG_IDF_TARGET="esp32s3"
CONFIG_ESPTOOLPY_FLASHMODE_DIO=y
CONFIG_ESPTOOLPY_FLASHFREQ_40M=y
CONFIG_ESPTOOLPY_FLASHSIZE_4MB=y
CONFIG_PARTITION_TABLE_CUSTOM=y
CONFIG_PARTITION_TABLE_CUSTOM_FILENAME="partitions.csv"
CONFIG_ESP_CONSOLE_UART_DEFAULT=y
CONFIG_ESP_MAIN_TASK_STACK_SIZE=8192
CONFIG_LOG_DEFAULT_LEVEL_NONE=y
CONFIG_BOOTLOADER_LOG_LEVEL_WARN=y
CONFIG_LWIP_IP_FORWARD=y
CONFIG_LWIP_IPV4_NAPT=y
CONFIG_LWIP_IPV6=n
CONFIG_LWIP_TCPIP_TASK_STACK_SIZE=4096
CONFIG_TINYUSB_NET_MODE_ECM_RNDIS=y
CONFIG_TINYUSB_DEBUG_LEVEL=0
CONFIG_EMU_LINUX_RNDIS=y
CONFIG_EMU_AT_USB=n
CONFIG_TINYUSB_CDC_ENABLED=n
CONFIG_ESP_WIFI_NVS_ENABLED=n
```
